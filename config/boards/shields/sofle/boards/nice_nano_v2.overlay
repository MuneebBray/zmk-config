/ {
};

&pro_micro_i2c {
    // Replace the default node at 0x3C with 0x3D
    /delete-node/ ssd1306@3c;
    ssd1306@3d {
        compatible = "solomon,ssd1306fb";
        reg = <0x3d>;
        label = "DISPLAY";
        width = <128>;
        height = <32>;
        segment-offset = <0>;
        page-offset = <0>;
        display-offset = <0>;
        multiplex-ratio = <31>;
        segment-remap;
        com-invdir;
        com-sequential;
        prechargep = <0x22>;
    };
};
